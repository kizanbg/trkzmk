## zephyr/Kconfig
```kconfig
menu "trk keyboard features"

config TRK_RGB_STATUS_INDICATOR
	bool "Show battery, connection, and Caps Lock status on the RGB strip"
	default y
	depends on ZMK_RGB_UNDERGLOW

endmenu
```
